
/dts-v1/;
/plugin/;

/ {
	compatible = "brcm,bcm2708", "brcm,bcm2709", "brcm,bcm2710";

	fragment@0 {
		target = <&spi0>;
		__overlay__ {
			#address-cells = <1>;
			#size-cells = <0>;
			status = "okay";

			adis16495-1@0 {
				compatible = "adis16495-1";
				reg = <0>;
				spi-max-frequency = <3200000>;
				spi-cpol;
				spi-cpha;
				interrupts = <25 2>;
				interrupt-parent = <&gpio>;
				interrupt-names = "DIO2";
			};
		};
	};
};
